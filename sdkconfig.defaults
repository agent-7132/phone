## sdkconfig.defaults
```kconfig
CONFIG_BT_ENABLED=y
CONFIG_BT_CONTROLLER_DISABLED=y
CONFIG_BT_NIMBLE_ENABLED=y
CONFIG_BT_NIMBLE_ROLE_PERIPHERAL=y
CONFIG_BT_NIMBLE_ROLE_CENTRAL=y
CONFIG_BT_NIMBLE_MAX_CONNECTIONS=3
CONFIG_BT_NIMBLE_TRANSPORT_UART=n

CONFIG_ESP_WIFI_REMOTE_LIBRARY_HOSTED=y
CONFIG_SLAVE_IDF_TARGET_ESP32C6=y
CONFIG_BSP_USB_HOST_ENABLE=y
CONFIG_USB_HOST_ENABLE=y

CONFIG_ESP_HOSTED_ENABLE_BT_NIMBLE=y
CONFIG_ESP_HOSTED_NIMBLE_HCI_VHCI=y
CONFIG_ESP_HOSTED_SDIO_SLOT_1=y
CONFIG_ESP_HOSTED_CP_TARGET_ESP32C6=y
CONFIG_ESP_HOSTED_SDIO_CLOCK_FREQ_KHZ=40000
CONFIG_ESP_DEFAULT_CPU_FREQ_MHZ_360=y
CONFIG_ESP_DEFAULT_CPU_FREQ_MHZ=360

CONFIG_PARTITION_TABLE_CUSTOM=y
CONFIG_PARTITION_TABLE_CUSTOM_FILENAME="partitions.csv"

CONFIG_ESPTOOLPY_FLASHSIZE_16MB=y

CONFIG_SPIRAM=y
CONFIG_SPIRAM_SPEED_200M=y
CONFIG_SPIRAM_XIP_FROM_PSRAM=y
CONFIG_SPIRAM_ALLOW_BSS_SEG_EXTERNAL_MEMORY=y
CONFIG_SPIRAM_ALLOW_NOINIT_SEG_EXTERNAL_MEMORY=y
CONFIG_SPIRAM_USE_MALLOC=y

CONFIG_LV_COLOR_DEPTH_16=y
CONFIG_LV_USE_PERF_MONITOR=y
CONFIG_LV_LOG_LEVEL_ERROR=y

CONFIG_HEAP_TRACING_STANDALONE=y
CONFIG_HEAP_TRACING_STACK_DEPTH=4

CONFIG_SPIFFS_CACHE=n

CONFIG_PM_ENABLE=y

CONFIG_USB_HOST_ENABLE=y
CONFIG_USB_HOST_HS=y

CONFIG_FATFS_MAX_LFN=255
CONFIG_FATFS_CODEPAGE_437=y
CONFIG_FATFS_USE_LFN=y
CONFIG_FATFS_EXFAT=y

CONFIG_I2C_ENABLE_DEBUG_LOG=n
CONFIG_I2C_ISR_IN_IRAM=y

CONFIG_COMPILER_OPTIMIZATION_SIZE=y

CONFIG_LOG_DEFAULT_LEVEL_INFO=y

CONFIG_NVS_ENCRYPTION=n
```

## temp/00_board_check/sdkconfig.defaults
```kconfig
# ESP-IDF项目默认配置文件
# 本文件定义项目的默认编译配置选项，使用idf.py save-defconfig生成，可手动编辑
# 基于Espressif IoT Development Framework (ESP-IDF) 5.4.0项目最小配置

# ==================== 目标芯片配置 ====================
# 指定目标芯片为ESP32-P4
CONFIG_IDF_TARGET="esp32p4"

# ==================== Flash配置 ====================
# 设置Flash工作模式为QIO（Quad I/O），支持更高的读写速度
CONFIG_ESPTOOLPY_FLASHMODE_QIO=y
# 设置Flash容量为16MB
CONFIG_ESPTOOLPY_FLASHSIZE_16MB=y

# ==================== 编译器优化配置 ====================
# 设置编译器优化级别为性能优先（-O2），平衡代码大小和执行速度
CONFIG_COMPILER_OPTIMIZATION_PERF=y

# ==================== PSRAM配置 ====================
# 启用外部PSRAM支持
CONFIG_SPIRAM=y
# 设置PSRAM工作速度为200MHz
CONFIG_SPIRAM_SPEED_200M=y
# 启用从PSRAM执行代码（XIP）功能，扩展代码空间
CONFIG_SPIRAM_XIP_FROM_PSRAM=y

# ==================== 缓存配置 ====================
# 设置L2缓存大小为256KB，提升内存访问性能
CONFIG_CACHE_L2_CACHE_256KB=y
# 设置缓存行大小为128字节，优化数据预取效率
CONFIG_CACHE_L2_CACHE_LINE_128B=y

# ==================== 主任务栈配置 ====================
# 设置主任务（app_main）的栈大小为10240字节（10KB）
CONFIG_ESP_MAIN_TASK_STACK_SIZE=10240

# ==================== FreeRTOS配置 ====================
# 设置FreeRTOS系统时钟频率为1000Hz（1ms tick），提高任务调度精度
CONFIG_FREERTOS_HZ=1000
# 在vTaskList输出中包含核心ID信息，便于多核调试
CONFIG_FREERTOS_VTASKLIST_INCLUDE_COREID=y
# 启用运行时统计功能，用于任务执行时间分析
CONFIG_FREERTOS_GENERATE_RUN_TIME_STATS=y
```

## temp/02_HelloWorld/sdkconfig.defaults
```kconfig
# ESP-IDF项目默认配置文件
# 该文件包含项目编译时的默认配置选项，会在执行 idf.py menuconfig 时作为默认值加载
# 文件由 idf.py save-defconfig 生成，可手动编辑以调整默认配置

# ESP-IDF版本：5.4.0 最小配置模板


# ==================== 目标芯片配置 ====================
# 编译目标芯片型号，当前配置为 ESP32-P4
CONFIG_IDF_TARGET="esp32p4"


# ==================== Flash配置 ====================
# Flash工作模式：QIO模式（Quad I/O，四线输入输出），提供更高的读取带宽
CONFIG_ESPTOOLPY_FLASHMODE_QIO=y

# Flash容量：16MB
CONFIG_ESPTOOLPY_FLASHSIZE_16MB=y


# ==================== 编译器优化配置 ====================
# 编译优化级别：性能优先（Performance）
# 其他可选值：
#   - CONFIG_COMPILER_OPTIMIZATION_DEBUG: 调试模式，包含完整调试信息
#   - CONFIG_COMPILER_OPTIMIZATION_SIZE: 尺寸优先，生成最小代码
CONFIG_COMPILER_OPTIMIZATION_PERF=y


# ==================== PSRAM配置 ====================
# 启用PSRAM（外部SPI RAM）
CONFIG_SPIRAM=y

# PSRAM工作速度：200MHz
CONFIG_SPIRAM_SPEED_200M=y

# 启用从PSRAM执行代码（XIP from PSRAM）
# 允许将部分代码存储在PSRAM中并直接执行，减少Flash访问压力
CONFIG_SPIRAM_XIP_FROM_PSRAM=y


# ==================== 缓存配置 ====================
# L2缓存大小：256KB
CONFIG_CACHE_L2_CACHE_256KB=y

# L2缓存行大小：128字节
# 缓存行大小影响缓存命中率和内存访问效率，较大的缓存行适合连续访问模式
CONFIG_CACHE_L2_CACHE_LINE_128B=y


# ==================== 主任务配置 ====================
# 主任务（app_main所在任务）堆栈大小：10240字节（10KB）
# 堆栈大小应根据实际应用需求调整，堆栈溢出会导致系统崩溃
CONFIG_ESP_MAIN_TASK_STACK_SIZE=10240


# ==================== FreeRTOS配置 ====================
# FreeRTOS系统节拍频率：1000Hz（1ms）
# 更高的频率提供更精确的延时，但会增加系统开销
CONFIG_FREERTOS_HZ=1000

# 在任务列表中包含核心ID信息
# 启用后，vTaskList()输出将包含任务运行的CPU核心编号
CONFIG_FREERTOS_VTASKLIST_INCLUDE_COREID=y

# 启用运行时统计功能
# 允许收集任务运行时间统计信息，用于性能分析和任务调度优化
CONFIG_FREERTOS_GENERATE_RUN_TIME_STATS=y
```

## temp/03_nvs_counter/sdkconfig.defaults
```kconfig
# ESP-IDF 项目默认配置文件
# 
# 此文件包含项目的默认 SDK 配置选项，这些选项会在运行 idf.py menuconfig 时
# 作为默认值加载。用户可以通过 menuconfig 工具修改这些配置，修改后的配置
# 会保存到 sdkconfig 文件中。
#
# 注意：
#   1. sdkconfig.defaults 中的配置项优先级低于 sdkconfig 文件中的配置项
#   2. 如果 sdkconfig 文件不存在，构建系统会使用此文件作为默认配置
#   3. 修改此文件后，需要删除 sdkconfig 文件并重新运行 idf.py build 才能生效

# 目标芯片配置
CONFIG_IDF_TARGET="esp32p4"        # 指定目标芯片为 ESP32-P4

# Flash 配置
CONFIG_ESPTOOLPY_FLASHMODE_QIO=y   # Flash 读写模式设置为 QIO（四输入输出）
CONFIG_ESPTOOLPY_FLASHSIZE_16MB=y  # Flash 容量设置为 16MB

# 编译器优化配置
CONFIG_COMPILER_OPTIMIZATION_PERF=y # 使用性能优化模式（-O2）

# PSRAM（伪静态随机存储器）配置
CONFIG_SPIRAM=y                    # 启用 PSRAM（外部 RAM）支持
CONFIG_SPIRAM_SPEED_200M=y         # PSRAM 工作频率设置为 200MHz
CONFIG_SPIRAM_XIP_FROM_PSRAM=y     # 启用从 PSRAM 执行代码（XIP）功能

# 缓存配置
CONFIG_CACHE_L2_CACHE_256KB=y      # L2 缓存大小设置为 256KB
CONFIG_CACHE_L2_CACHE_LINE_128B=y  # L2 缓存行大小设置为 128 字节

# FreeRTOS 配置
CONFIG_ESP_MAIN_TASK_STACK_SIZE=10240   # 主任务（app_main）堆栈大小设置为 10KB
CONFIG_FREERTOS_HZ=1000                 # FreeRTOS 时钟节拍频率设置为 1000Hz
CONFIG_FREERTOS_VTASKLIST_INCLUDE_COREID=y  # 在任务列表中显示 CPU 核心 ID
CONFIG_FREERTOS_GENERATE_RUN_TIME_STATS=y   # 启用运行时统计功能（用于任务监控和调试）
```

## temp/04_freertos_tasks/sdkconfig.defaults
```kconfig
# ESP-IDF项目默认配置文件
# 
# 此文件包含项目的默认SDK配置选项，这些选项会在运行idf.py menuconfig时
# 作为默认值加载。用户可以通过menuconfig工具修改这些配置，修改后的配置
# 会保存到sdkconfig文件中。
#
# 注意：
#   1. sdkconfig.defaults中的配置项优先级低于sdkconfig文件中的配置项
#   2. 如果sdkconfig文件不存在，构建系统会使用此文件作为默认配置
#   3. 修改此文件后，需要删除sdkconfig文件并重新运行idf.py build才能生效

# 目标芯片配置
CONFIG_IDF_TARGET="esp32p4"        # 指定目标芯片为ESP32-P4

# Flash配置
CONFIG_ESPTOOLPY_FLASHMODE_QIO=y   # Flash读写模式设置为QIO（四输入输出）
CONFIG_ESPTOOLPY_FLASHSIZE_16MB=y  # Flash容量设置为16MB

# 编译器优化配置
CONFIG_COMPILER_OPTIMIZATION_PERF=y # 使用性能优化模式（-O2）

# PSRAM（伪静态随机存储器）配置
CONFIG_SPIRAM=y                    # 启用PSRAM（外部RAM）支持
CONFIG_SPIRAM_SPEED_200M=y         # PSRAM工作频率设置为200MHz
CONFIG_SPIRAM_XIP_FROM_PSRAM=y     # 启用从PSRAM执行代码（XIP）功能

# 缓存配置
CONFIG_CACHE_L2_CACHE_256KB=y      # L2缓存大小设置为256KB
CONFIG_CACHE_L2_CACHE_LINE_128B=y  # L2缓存行大小设置为128字节

# FreeRTOS配置
CONFIG_ESP_MAIN_TASK_STACK_SIZE=10240   # 主任务（app_main）堆栈大小设置为10KB
CONFIG_FREERTOS_HZ=1000                 # FreeRTOS时钟节拍频率设置为1000Hz
CONFIG_FREERTOS_VTASKLIST_INCLUDE_COREID=y  # 在任务列表中显示CPU核心ID
CONFIG_FREERTOS_GENERATE_RUN_TIME_STATS=y   # 启用运行时统计功能（用于任务监控和调试）
```

## temp/05_gpio_io/main/Kconfig.projbuild
```kconfig
# GPIO IO示例配置菜单
# 
# 该文件定义了menuconfig中"GPIO IO Example Configuration"菜单下的配置选项，
# 用户可以通过idf.py menuconfig命令修改这些配置。

# 定义配置菜单名称
menu "GPIO IO Example Configuration"

    # 输出GPIO编号配置
    config EXAMPLE_GPIO_OUTPUT
        int "Output GPIO number"  # 配置项名称
        default 2                # 默认值为GPIO2

    # 输入GPIO编号配置
    config EXAMPLE_GPIO_INPUT
        int "Input GPIO number"   # 配置项名称
        default 3                # 默认值为GPIO3

    # 输入GPIO上拉使能配置
    config EXAMPLE_GPIO_INPUT_PULLUP
        bool "Enable input pull-up"  # 配置项名称（布尔类型）
        default y                    # 默认启用上拉电阻

endmenu  # 结束配置菜单定义
```

## temp/06_gpio_interrupt/main/Kconfig.projbuild
```kconfig
menu "GPIO Interrupt Example Configuration"

    config EXAMPLE_GPIO_INPUT
        int "Input GPIO number"
        default 3

    config EXAMPLE_GPIO_INPUT_PULLUP
        bool "Enable input pull-up"
        default y

    config EXAMPLE_DEBOUNCE_MS
        int "Debounce time in ms"
        default 50

endmenu
```

## temp/07_uart_loopback/main/Kconfig.projbuild
```kconfig
menu "UART Loopback Example Configuration"

    config EXAMPLE_UART_PORT_NUM
        int "UART port number"
        default 1

    config EXAMPLE_UART_TX_GPIO
        int "TX GPIO number"
        default 43

    config EXAMPLE_UART_RX_GPIO
        int "RX GPIO number"
        default 44

    config EXAMPLE_UART_BAUD_RATE
        int "Baud rate"
        default 115200

endmenu
```

## temp/16_video_lcd_display/sdkconfig.defaults
```kconfig
# ============================================================
# ESP-IDF 项目默认配置文件
# ============================================================
# 本文件定义了项目的默认SDK配置参数，构建时会作为基础配置加载。
# 用户可以通过 idf.py menuconfig 修改这些配置。

# -------------------------- 目标芯片配置 --------------------------
CONFIG_IDF_TARGET="esp32p4"              # 目标芯片：ESP32-P4

# -------------------------- CSI摄像头配置 --------------------------
CONFIG_EXAMPLE_MIPI_CSI_SCCB_I2C_SCL_PIN=8    # SCCB/I2C时钟引脚：GPIO8
CONFIG_EXAMPLE_MIPI_CSI_SCCB_I2C_SDA_PIN=7    # SCCB/I2C数据引脚：GPIO7
CONFIG_CAMERA_OV5647=y                         # 启用OV5647摄像头驱动
CONFIG_CAMERA_OV5647_MIPI_RAW8_800x1280_50FPS=y  # OV5647配置：RAW8格式，800x1280分辨率，50FPS
CONFIG_CAM_CTRL_SPI_ENABLE=n                  # 禁用摄像头SPI控制
CONFIG_ESP_VIDEO_ENABLE_ISP_PIPELINE_CONTROLLER=y  # 启用ISP管线控制器

# -------------------------- SPIRAM配置 --------------------------
CONFIG_SPIRAM=y                            # 启用外部SPIRAM
CONFIG_SPIRAM_SPEED_200M=y                 # SPIRAM速度：200MHz
CONFIG_SPIRAM_XIP_FROM_PSRAM=y             # 允许从PSRAM执行代码（XIP）

# -------------------------- 缓存配置 --------------------------
CONFIG_CACHE_L2_CACHE_256KB=y              # L2缓存大小：256KB
CONFIG_CACHE_L2_CACHE_LINE_128B=y          # L2缓存行大小：128字节

# -------------------------- FreeRTOS配置 --------------------------
CONFIG_FREERTOS_HZ=1000                    # FreeRTOS时钟频率：1000Hz
CONFIG_FREERTOS_VTASKLIST_INCLUDE_COREID=y # 在任务列表中显示核心ID
CONFIG_FREERTOS_GENERATE_RUN_TIME_STATS=y  # 生成运行时统计信息
CONFIG_ESP_MAIN_TASK_STACK_SIZE=10240      # 主任务堆栈大小：10KB

# -------------------------- 网络配置 --------------------------
CONFIG_LWIP_HOOK_IP6_INPUT_NONE=y          # 禁用IPv6输入钩子

# -------------------------- 构建配置 --------------------------
CONFIG_IDF_EXPERIMENTAL_FEATURES=y         # 启用实验性功能
CONFIG_COMPILER_OPTIMIZATION_PERF=y        # 编译优化：性能优先

# -------------------------- Flash配置 --------------------------
CONFIG_ESPTOOLPY_FLASHMODE_QIO=y           # Flash模式：QIO
CONFIG_ESPTOOLPY_FLASHSIZE_16MB=y          # Flash大小：16MB
CONFIG_PARTITION_TABLE_CUSTOM=y            # 使用自定义分区表

# -------------------------- LVGL配置 --------------------------
CONFIG_LV_USE_CLIB_MALLOC=y                # 使用标准库malloc
CONFIG_LV_USE_CLIB_STRING=y                # 使用标准库字符串函数
CONFIG_LV_USE_CLIB_SPRINTF=y               # 使用标准库sprintf
CONFIG_LV_DEF_REFR_PERIOD=15               # 默认刷新周期：15ms（约66FPS）
CONFIG_LV_OS_FREERTOS=y                    # 使用FreeRTOS作为LVGL操作系统
CONFIG_LV_DRAW_SW_DRAW_UNIT_CNT=2          # 软件绘制单元数量：2

# LVGL字体配置
CONFIG_LV_FONT_MONTSERRAT_12=y             # 启用Montserrat 12号字体
CONFIG_LV_FONT_MONTSERRAT_16=y             # 启用Montserrat 16号字体
CONFIG_LV_FONT_MONTSERRAT_18=y             # 启用Montserrat 18号字体
CONFIG_LV_FONT_MONTSERRAT_20=y             # 启用Montserrat 20号字体
CONFIG_LV_FONT_MONTSERRAT_22=y             # 启用Montserrat 22号字体
CONFIG_LV_FONT_MONTSERRAT_24=y             # 启用Montserrat 24号字体
CONFIG_LV_FONT_MONTSERRAT_26=y             # 启用Montserrat 26号字体
CONFIG_LV_USE_FONT_COMPRESSED=y            # 启用字体压缩

# LVGL文本配置
CONFIG_LV_TXT_BREAK_CHARS=" ,.;:-_"        # 文本换行分隔符

# LVGL功能配置
CONFIG_LV_USE_SYSMON=y                     # 启用系统监视器
CONFIG_LV_USE_PERF_MONITOR=y               # 启用性能监视器
CONFIG_LV_USE_IMGFONT=y                    # 启用图像字体

# LVGL演示配置
CONFIG_LV_USE_DEMO_WIDGETS=y               # 启用Widgets演示
CONFIG_LV_USE_DEMO_BENCHMARK=y             # 启用Benchmark演示
CONFIG_LV_USE_DEMO_RENDER=y                # 启用Render演示
CONFIG_LV_USE_DEMO_SCROLL=y                # 启用Scroll演示
CONFIG_LV_USE_DEMO_STRESS=y                # 启用Stress演示
CONFIG_LV_USE_DEMO_TRANSFORM=y             # 启用Transform演示
CONFIG_LV_USE_DEMO_MUSIC=y                 # 启用Music演示
CONFIG_LV_DEMO_MUSIC_AUTO_PLAY=y           # Music演示自动播放
CONFIG_LV_USE_DEMO_FLEX_LAYOUT=y           # 启用Flex布局演示
CONFIG_LV_USE_DEMO_MULTILANG=y             # 启用多语言演示

# -------------------------- BSP LCD配置 --------------------------
CONFIG_BSP_LCD_DPI_BUFFER_NUMS=3           # LCD DPI缓冲区数量：3个
```

## temp/18_esp_brookesia_phone/sdkconfig.defaults
```kconfig
# ESP-Brookesia Phone SDK Configuration
# Supports ESP-IDF 5.3 to 6.x

# Target Configuration
CONFIG_IDF_TARGET="esp32p4"

# Flash Configuration
CONFIG_ESPTOOLPY_FLASHMODE_QIO=y
CONFIG_ESPTOOLPY_FLASHSIZE_16MB=y
CONFIG_PARTITION_TABLE_CUSTOM=y

# Compiler Optimization
CONFIG_COMPILER_OPTIMIZATION_PERF=y

# PSRAM Configuration
CONFIG_SPIRAM=y
CONFIG_SPIRAM_SPEED_200M=y
CONFIG_SPIRAM_XIP_FROM_PSRAM=y

# Cache Configuration
CONFIG_CACHE_L2_CACHE_256KB=y
CONFIG_CACHE_L2_CACHE_LINE_128B=y

# FreeRTOS Configuration
CONFIG_FREERTOS_HZ=1000
CONFIG_FREERTOS_VTASKLIST_INCLUDE_COREID=y
CONFIG_FREERTOS_GENERATE_RUN_TIME_STATS=y

# ESP-Brookesia Feature Configuration
CONFIG_ESP_BROOKESIA_ENABLE_AI_FRAMEWORK=n
CONFIG_ESP_BROOKESIA_GUI_ENABLE_ANIM_PLAYER=n
CONFIG_ESP_BROOKESIA_ENABLE_SERVICES=n
CONFIG_ESP_BROOKESIA_SYSTEMS_ENABLE_SPEAKER=n

# Boost Library Configuration
CONFIG_BOOST_MATH_ENABLED=n
CONFIG_BOOST_SERIALIZATION_ENABLED=n

# LVGL Configuration
CONFIG_LV_USE_CLIB_MALLOC=y
CONFIG_LV_OS_FREERTOS=y
CONFIG_LV_USE_CLIB_STRING=y
CONFIG_LV_USE_CLIB_SPRINTF=y
CONFIG_LV_DEF_REFR_PERIOD=15
CONFIG_LV_OBJ_STYLE_CACHE=y
CONFIG_LV_DRAW_SW_DRAW_UNIT_CNT=2
CONFIG_LV_USE_LOG=y
CONFIG_LV_LOG_PRINTF=y

# LVGL Font Configuration
CONFIG_LV_FONT_MONTSERRAT_8=y
CONFIG_LV_FONT_MONTSERRAT_10=y
CONFIG_LV_FONT_MONTSERRAT_12=y
CONFIG_LV_FONT_MONTSERRAT_16=y
CONFIG_LV_FONT_MONTSERRAT_18=y
CONFIG_LV_FONT_MONTSERRAT_20=y
CONFIG_LV_FONT_MONTSERRAT_22=y
CONFIG_LV_FONT_MONTSERRAT_24=y
CONFIG_LV_FONT_MONTSERRAT_26=y
CONFIG_LV_FONT_MONTSERRAT_28=y
CONFIG_LV_FONT_MONTSERRAT_30=y
CONFIG_LV_FONT_MONTSERRAT_32=y
CONFIG_LV_FONT_MONTSERRAT_34=y
CONFIG_LV_FONT_MONTSERRAT_36=y
CONFIG_LV_FONT_MONTSERRAT_38=y
CONFIG_LV_FONT_MONTSERRAT_40=y
CONFIG_LV_FONT_MONTSERRAT_42=y
CONFIG_LV_FONT_MONTSERRAT_44=y
CONFIG_LV_FONT_FMT_TXT_LARGE=y
CONFIG_LV_USE_FONT_COMPRESSED=y
CONFIG_LV_USE_SNAPSHOT=y

# IDF Experimental Features
CONFIG_IDF_EXPERIMENTAL_FEATURES=y

# LVGL Build Configuration
CONFIG_LV_BUILD_EXAMPLES=n

# BSP Display Configuration
CONFIG_BSP_LCD_DPI_BUFFER_NUMS=3
CONFIG_BSP_LCD_TYPE_720_1280_7_INCH_A=y

# IDF 6.x Compatibility Configuration
# CONFIG_EXPERIMENTAL_CPU_SW_ISR_TABLE=y
```
